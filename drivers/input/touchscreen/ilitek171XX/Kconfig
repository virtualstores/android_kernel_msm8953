## drivers/input/touchscreen/ilitek171XX/Kconfig
```kconfig
#
# Ilitek 171XX driver
#
config ILITEK171XX_DRIVER
	tristate "Ilitek 171XX driver"
	depends on TOUCHSCREEN_ILITEK171XX
	help
	  This is the main file for touchpanel driver for Ilitek171XX 
	  touchscreens

	  Say Y here if you have a Ilitek171XX touch screen connected
	  to your system

	  If unsure, say N.
```

## drivers/video/msm/msm_dba/Kconfig
```kconfig
#
# MSM DBA
#

config MSM_DBA
	bool "MSM Display Bridge Abstraction support"
	depends on ARM || ARM64
	---help---
	  Support for MSM display bridge abstraction interface. MSM display
	  drivers can use the same interface to interact with different third
	  party bridge chips. Drivers implemented for third party bridge chips
	  should support this interface to allow display driver to control the
	  bridge chip. The MSM DBA driver maintains a list of devices supported
	  on the platform and allow clients to register and access these
	  devices.

config MSM_DBA_ADV7533
	bool "ADV7533 driver support through MSM DBA interface"
	depends on MSM_DBA
	default n
	---help---
	  Support for ADV7533 DSI to HDMI display bridge driver. The driver
	  controls the ADV7533 HW through the I2C interface and configures
	  the DSI input and HDMI output video format.

config MSM_DBA_LT8912
	bool "LT8912 driver support through MSM DBA interface"
	depends on MSM_DBA
	default n
	---help---
	  Support for LT8912 DSI to HDMI display bridge driver. The driver
	  controls the LT8912 HW through the I2C interface and configures
	  the DSI input and HDMI output video format.

config MSM_DBA_DSI1_BRIDGE
        tristate "Dsi1 bridge driver support for dual mipi through MSM DBA interface"
        depends on MSM_DBA
        ---help---
          Support for a fake DSI to HDMI display bridge driver.
```
